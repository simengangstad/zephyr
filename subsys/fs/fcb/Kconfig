## subsys/fs/fcb/Kconfig
```kconfig
# Flash Circular Buffer module

# Copyright (c) 2017-2023 Nordic Semiconductor ASA
# SPDX-License-Identifier: Apache-2.0

#
# Flash Circular Buffer
#

config FCB
	bool "Flash Circular Buffer support"
	depends on FLASH_MAP
	select CRC
	select FLASH_PAGE_LAYOUT
	help
	  Enable support of Flash Circular Buffer.

if FCB

config FCB_ALLOW_FIXED_ENDMARKER
	bool "Allow FCB instances to have a fixed endmarker"
	help
	  This allows the FCB instances to disable CRC checks in
	  favor of increased write throughput.

config FCB_ERASE_SECTOR_ON_HDR_CHECKSUM_ERROR
	bool "Erase sector when checksum error in header is detected"
	default n
	help
	  This prevents the initialization of the FCB to fail if one
	  or more sector headers are corrupted. This can happen when
	  power loss occurs whilst writing the sector header.


endif
```
